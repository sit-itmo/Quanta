## firmware/esp8266/main/Kconfig.projbuild
```kconfig
menu "Quanta firmware"
config QUANTA_MEASURE_VDD33
    bool "Enable SDK VDD33 measurement (TOUT must be unconnected)"
    default n
    help
        Requires ESP PHY init vdd33_const=255 and a board with TOUT unconnected.
        Leave disabled if ADC is connected. Does not initialize Wi-Fi itself.
endmenu
```

## firmware/esp8266/reference/sdkconfig.defaults.original
```kconfig
CONFIG_FREERTOS_HZ=1000
CONFIG_ESP_MAIN_TASK_STACK_SIZE=4096CONFIG_ESP_PHY_INIT_DATA_VDD33_CONST=255
# NEWLIB_NANO_FORMAT is not set
```
